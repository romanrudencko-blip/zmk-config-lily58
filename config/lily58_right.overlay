/*
 * Copyright (c) 2020 Pete Johanson
 *
 * SPDX-License-Identifier: MIT
 */

#include "lily58.dtsi"

 {
    right_encoder: encoder_right {
        compatible = "alps,ec11";
        /* Замените pro_micro на соответствующий label вашего контроллера */
        a-gpios = <&pro_micro 18 (GPIO_ACTIVE_HIGH | GPIO_PULL_UP)>;
        b-gpios = <&pro_micro 19 (GPIO_ACTIVE_HIGH | GPIO_PULL_UP)>;
        resolution = <4>;
    };

    sensors {
        compatible = "zmk,keymap-sensors";
        sensors = <&right_encoder>;
    };
};
